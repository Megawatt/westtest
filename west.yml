## west.yml
```yaml
# 
# West.yml
# 
# Top level west manifest
#
#
#
manifest:
  remotes:
    - name: main_proj
      url-base: https://github.com/Megawatt

  projects:
    - name: hexdump
      remote: main_proj
      repo-path: hexdump
      path: hexdump
      revision: 6c0d11cc77e98498db83c065c4cf9eed328804b2

  self:
    path: westtest

  
```
